## CMakeLists.txt
```
# SPDX-License-Identifier: Apache-2.0

cmake_minimum_required(VERSION 3.20.0)

# Add fusain module to the build
list(APPEND EXTRA_ZEPHYR_MODULES ${CMAKE_CURRENT_SOURCE_DIR}/..)

find_package(Zephyr REQUIRED HINTS $ENV{ZEPHYR_BASE})
project(fusain_tests)

# Add test source files
target_sources(app PRIVATE
  src/main.c
  src/test_crc.c
  src/test_encoding.c
  src/test_decoding.c
  src/test_packet_creation.c
  src/test_fuzz.c
)

# Add net_buf tests when CONFIG_FUSAIN_NET_BUF is enabled
if(CONFIG_FUSAIN_NET_BUF)
  target_sources(app PRIVATE
    src/test_net_buf.c
  )
endif()

# Add test include directory
target_include_directories(app PRIVATE
  ${CMAKE_CURRENT_SOURCE_DIR}/src
)
```

## Kconfig
```
# SPDX-License-Identifier: Apache-2.0

config FUSAIN_TEST_FUZZ_ROUNDS
	int "Number of fuzz test rounds"
	default 100
	help
	  Number of fuzzing iterations with random values.
	  Higher values increase coverage of edge cases.
	  Functional tests use fixed test cases and do not use this config.

config FUSAIN_TEST_FUZZ_SEED
	hex "Fuzz test random seed"
	default 0x0
	help
	  Seed for the fuzz test random number generator.
	  Set to 0 for random seed (default), or specify a
	  hex value to reproduce a specific test failure.
	  The seed is printed at the start of each fuzz test run.

source "Kconfig.zephyr"
```

## prj.conf
```kconfig
# SPDX-License-Identifier: Apache-2.0

# Enable Ztest framework
CONFIG_ZTEST=y

# Enable sufficient heap for tests
CONFIG_HEAP_MEM_POOL_SIZE=16384

# Enable fusain library
CONFIG_FUSAIN=y

# Enable random subsystem for fuzz tests
# Note: On native_sim, entropy is deterministic for reproducibility.
# Real hardware will have different seeds each run.
CONFIG_ENTROPY_GENERATOR=y
CONFIG_FAKE_ENTROPY_NATIVE_SIM=y

# Test configuration (fuzz tests only)
CONFIG_FUSAIN_TEST_FUZZ_ROUNDS=100

# Enable floating point for temperature tests
CONFIG_FPU=y
CONFIG_FPU_SHARING=y

# Logging (optional, for debugging tests)
# CONFIG_LOG=y
# CONFIG_FUSAIN_LOG_LEVEL_DBG=y
```

## coverage.conf
```kconfig
# SPDX-License-Identifier: Apache-2.0
# Coverage configuration overlay

CONFIG_COVERAGE=y
CONFIG_COVERAGE_GCOV=y
```

## src/main.c
```c
/*
 * Copyright (c) 2025 Kaz Walker, Thermoquad
 * SPDX-License-Identifier: Apache-2.0
 *
 * Fusain Protocol Library - Test Suite Entry Point
 *
 * Note: Zephyr's ztest framework provides its own main() function
 * and auto-discovers test suites. This file is kept for organization
 * but doesn't define main().
 */

#include <zephyr/ztest.h>

/* Test suites are defined in their respective files and auto-discovered by ztest */
```

## src/test_crc.c
```c
/*
 * Copyright (c) 2025 Kaz Walker, Thermoquad
 * SPDX-License-Identifier: Apache-2.0
 *
 * Fusain Protocol Library - CRC-16-CCITT Tests
 */

#include <fusain/fusain.h>
#include <string.h>
#include <zephyr/ztest.h>

/* Test CRC calculation with known values */
ZTEST(fusain_crc, test_crc_known_values)
{
  uint8_t data1[] = { 0x00 };
  uint16_t crc1 = fusain_crc16(data1, sizeof(data1));
  zassert_not_equal(crc1, 0, "CRC should not be zero for non-empty data");

  /* CRC should be different for different data */
  uint8_t data2[] = { 0x01 };
  uint16_t crc2 = fusain_crc16(data2, sizeof(data2));
  zassert_not_equal(crc1, crc2, "Different data should produce different CRCs");
}

/* Test CRC with empty data */
ZTEST(fusain_crc, test_crc_empty)
{
  uint8_t data[] = { 0x00 };
  uint16_t crc = fusain_crc16(data, 0);
  zassert_equal(crc, 0xFFFF, "CRC of empty data should be initial value 0xFFFF");
}

/* Test CRC determinism */
ZTEST(fusain_crc, test_crc_determinism)
{
  uint8_t data[] = { 0xDE, 0xAD, 0xBE, 0xEF };

  uint16_t crc1 = fusain_crc16(data, sizeof(data));
  uint16_t crc2 = fusain_crc16(data, sizeof(data));
  zassert_equal(crc1, crc2, "CRC should be deterministic");
}

/* Test CRC with various lengths */
ZTEST(fusain_crc, test_crc_various_lengths)
{
  uint8_t data[FUSAIN_MAX_PAYLOAD_SIZE];

  /* Fill with pattern */
  for (size_t i = 0; i < sizeof(data); i++) {
    data[i] = (uint8_t)(i & 0xFF);
  }

  /* Test different lengths */
  uint16_t prev_crc = 0xFFFF;
  for (size_t len = 1; len <= sizeof(data); len++) {
    uint16_t crc = fusain_crc16(data, len);
    /* Each length should produce a different CRC */
    zassert_not_equal(crc, prev_crc,
        "Different lengths should produce different CRCs (len=%zu)",
        len);
    prev_crc = crc;
  }
}

/* Test CRC byte order independence */
ZTEST(fusain_crc, test_crc_byte_order)
{
  uint8_t data1[] = { 0x12, 0x34 };
  uint8_t data2[] = { 0x34, 0x12 };

  uint16_t crc1 = fusain_crc16(data1, sizeof(data1));
  uint16_t crc2 = fusain_crc16(data2, sizeof(data2));

  /* Different byte order should produce different CRC */
  zassert_not_equal(crc1, crc2, "Byte order should affect CRC");
}

/* Test suite setup */
ZTEST_SUITE(fusain_crc, NULL, NULL, NULL, NULL, NULL);
```

## src/test_decoding.c
```c
/*
 * Copyright (c) 2025 Kaz Walker, Thermoquad
 * SPDX-License-Identifier: Apache-2.0
 *
 * Fusain Protocol Library - Packet Decoding Tests
 *
 * Wire format: [START][LENGTH][ADDRESS(8)][CBOR_PAYLOAD][CRC(2)][END]
 * CBOR payload contains [msg_type, payload_map]
 */

#include <fusain/fusain.h>
#include <string.h>
#include <zephyr/ztest.h>

/* Test basic round-trip encoding/decoding using helper functions */
ZTEST(fusain_decoding, test_roundtrip_basic)
{
  /* Use a helper function to create a valid CBOR packet */
  fusain_packet_t tx_packet;
  fusain_create_motor_command(&tx_packet, 0x1234, 0, 3000);

  /* Encode */
  uint8_t buffer[FUSAIN_MAX_PACKET_SIZE * 2];
  int encoded_len = fusain_encode_packet(&tx_packet, buffer, sizeof(buffer));
  zassert_true(encoded_len > 0, "Encoding should succeed");

  /* Decode */
  fusain_decoder_t decoder;
  fusain_reset_decoder(&decoder);

  fusain_packet_t rx_packet;
  fusain_decode_result_t result = FUSAIN_DECODE_INCOMPLETE;

  for (int i = 0; i < encoded_len; i++) {
    result = fusain_decode_byte(buffer[i], &rx_packet, &decoder);
    if (result == FUSAIN_DECODE_OK) {
      break;
    }
  }

  zassert_equal(result, FUSAIN_DECODE_OK, "Decoding should succeed");
  zassert_equal(rx_packet.length, tx_packet.length, "Length should match");
  zassert_equal(rx_packet.msg_type, tx_packet.msg_type, "Type should match");
  zassert_equal(rx_packet.address, tx_packet.address, "Address should match");
  zassert_mem_equal(rx_packet.payload, tx_packet.payload, tx_packet.length,
      "Payload should match");
}

/* Test decoding with nil payload (PING_REQUEST, DISCOVERY_REQUEST) */
ZTEST(fusain_decoding, test_roundtrip_empty_payload)
{
  /* In CBOR mode, PING_REQUEST has [type, nil] */
  fusain_packet_t tx_packet;
  fusain_create_ping_request(&tx_packet, 0x5678);

  uint8_t buffer[FUSAIN_MAX_PACKET_SIZE * 2];
  int encoded_len = fusain_encode_packet(&tx_packet, buffer, sizeof(buffer));
  zassert_true(encoded_len > 0, "Encoding should succeed");

  fusain_decoder_t decoder;
  fusain_reset_decoder(&decoder);

  fusain_packet_t rx_packet;
  fusain_decode_result_t result = FUSAIN_DECODE_INCOMPLETE;

  for (int i = 0; i < encoded_len; i++) {
    result = fusain_decode_byte(buffer[i], &rx_packet, &decoder);
  }

  zassert_equal(result, FUSAIN_DECODE_OK, "Should decode nil payload");
  zassert_equal(rx_packet.msg_type, FUSAIN_MSG_PING_REQUEST, "Type should match");
}

/* Test decoding with byte stuffing */
ZTEST(fusain_decoding, test_roundtrip_byte_stuffing)
{
  /* Create a packet where address or data contains escapable bytes */
  fusain_packet_t tx_packet;
  fusain_create_device_announce(&tx_packet, 0x7E7D7F01, 1, 1, 1, 1);
  /* Address contains START_BYTE, ESC_BYTE, END_BYTE which need escaping */

  uint8_t buffer[FUSAIN_MAX_PACKET_SIZE * 2];
  int encoded_len = fusain_encode_packet(&tx_packet, buffer, sizeof(buffer));

  fusain_decoder_t decoder;
  fusain_reset_decoder(&decoder);

  fusain_packet_t rx_packet;
  fusain_decode_result_t result = FUSAIN_DECODE_INCOMPLETE;

  for (int i = 0; i < encoded_len; i++) {
    result = fusain_decode_byte(buffer[i], &rx_packet, &decoder);
  }

  zassert_equal(result, FUSAIN_DECODE_OK, "Should decode stuffed bytes");
  zassert_equal(rx_packet.address, tx_packet.address, "Address should match after unstuffing");
}

/* Test decoding with CRC error */
ZTEST(fusain_decoding, test_decode_crc_error)
{
  fusain_packet_t tx_packet;
  fusain_create_motor_command(&tx_packet, 0x1234, 0, 2000);

  uint8_t buffer[FUSAIN_MAX_PACKET_SIZE * 2];
  int encoded_len = fusain_encode_packet(&tx_packet, buffer, sizeof(buffer));

  /* Corrupt a data byte (not START or END) */
  buffer[5] ^= 0xFF;

  fusain_decoder_t decoder;
  fusain_reset_decoder(&decoder);

  fusain_packet_t rx_packet;
  fusain_decode_result_t result = FUSAIN_DECODE_INCOMPLETE;

  for (int i = 0; i < encoded_len; i++) {
    result = fusain_decode_byte(buffer[i], &rx_packet, &decoder);
    if (result != FUSAIN_DECODE_INCOMPLETE) {
      break;
    }
  }

  zassert_equal(result, FUSAIN_DECODE_INVALID_CRC, "Should detect CRC error");
}

/* Test decoder reset */
ZTEST(fusain_decoding, test_decoder_reset)
{
  fusain_decoder_t decoder;

  /* Put decoder in some state */
  decoder.state = 5;
  decoder.buffer_index = 10;
  decoder.escape_next = true;

  /* Reset */
  fusain_reset_decoder(&decoder);

  zassert_equal(decoder.state, 0, "State should be reset");
  zassert_equal(decoder.buffer_index, 0, "Index should be reset");
  zassert_false(decoder.escape_next, "Escape flag should be reset");
}

/* Test decoding with large CBOR payload (motor_config has many fields) */
ZTEST(fusain_decoding, test_roundtrip_max_payload)
{
  /* Create a motor_config packet which has many CBOR fields
   * This tests the decoder's ability to handle larger payloads */
  fusain_cmd_motor_config_t config = {
    .motor = 0,
    .pwm_period = 1000000, /* Large value to increase CBOR size */
    .pid_kp = 4.0,
    .pid_ki = 12.0,
    .pid_kd = 0.1,
    .max_rpm = 3400,
    .min_rpm = 800,
    .min_pwm_duty = 500000, /* Large value to increase CBOR size */
  };

  fusain_packet_t tx_packet;
  fusain_create_motor_config(&tx_packet, 0xABCDEF0123456789, &config);

  zassert_true(tx_packet.length > 0, "CBOR payload should not be empty");

  uint8_t buffer[FUSAIN_MAX_PACKET_SIZE * 2];
  int encoded_len = fusain_encode_packet(&tx_packet, buffer, sizeof(buffer));

  fusain_decoder_t decoder;
  fusain_reset_decoder(&decoder);

  fusain_packet_t rx_packet;
  fusain_decode_result_t result = FUSAIN_DECODE_INCOMPLETE;

  for (int i = 0; i < encoded_len; i++) {
    result = fusain_decode_byte(buffer[i], &rx_packet, &decoder);
  }

  zassert_equal(result, FUSAIN_DECODE_OK, "Should decode large CBOR payload");
  zassert_equal(rx_packet.length, tx_packet.length, "Length should match");
  zassert_equal(rx_packet.msg_type, tx_packet.msg_type, "Type should match");
  zassert_mem_equal(rx_packet.payload, tx_packet.payload, tx_packet.length,
      "Payload should match");
}

/* Test round-trip consistency with various message types */
ZTEST(fusain_decoding, test_roundtrip_consistency)
{
  fusain_packet_t tx_packet;
  const char* test_names[] = { "ping_request", "set_mode", "state_data",
    "motor_command", "device_announce" };

  for (int i = 0; i < 5; i++) {
    switch (i) {
    case 0:
      fusain_create_ping_request(&tx_packet, 0x1111);
      break;
    case 1:
      fusain_create_state_command(&tx_packet, 0x2222, FUSAIN_MODE_HEAT, 2500);
      break;
    case 2:
      fusain_create_state_data(&tx_packet, 0x3333, 0, 0, FUSAIN_STATE_HEATING, 12345);
      break;
    case 3:
      fusain_create_motor_command(&tx_packet, 0x4444, 0, 3000);
      break;
    case 4:
      fusain_create_device_announce(&tx_packet, 0x5555, 1, 1, 1, 1);
      break;
    }

    uint8_t buffer[FUSAIN_MAX_PACKET_SIZE * 2];
    int encoded_len = fusain_encode_packet(&tx_packet, buffer, sizeof(buffer));

    fusain_decoder_t decoder;
    fusain_reset_decoder(&decoder);

    fusain_packet_t rx_packet;
    fusain_decode_result_t result = FUSAIN_DECODE_INCOMPLETE;

    for (int j = 0; j < encoded_len; j++) {
      result = fusain_decode_byte(buffer[j], &rx_packet, &decoder);
    }

    zassert_equal(result, FUSAIN_DECODE_OK,
        "%s: Decoding should succeed", test_names[i]);
    zassert_equal(rx_packet.length, tx_packet.length,
        "%s: Length should match", test_names[i]);
    zassert_equal(rx_packet.msg_type, tx_packet.msg_type,
        "%s: Type should match", test_names[i]);
    zassert_mem_equal(rx_packet.payload, tx_packet.payload, tx_packet.length,
        "%s: Payload should match", test_names[i]);
  }
}

/* Test decoder in IDLE state receiving non-START bytes */
ZTEST(fusain_decoding, test_decode_idle_garbage)
{
  fusain_decoder_t decoder;
  fusain_reset_decoder(&decoder);

  fusain_packet_t rx_packet;
  fusain_decode_result_t result;

  /* Send various non-START bytes while in IDLE state */
  result = fusain_decode_byte(0x00, &rx_packet, &decoder);
  zassert_equal(result, FUSAIN_DECODE_INCOMPLETE,
      "IDLE state should ignore non-START byte");

  result = fusain_decode_byte(0xFF, &rx_packet, &decoder);
  zassert_equal(result, FUSAIN_DECODE_INCOMPLETE,
      "IDLE state should ignore non-START byte");

  result = fusain_decode_byte(0x42, &rx_packet, &decoder);
  zassert_equal(result, FUSAIN_DECODE_INCOMPLETE,
      "IDLE state should ignore non-START byte");

  /* Decoder should still be in IDLE and ready to accept START */
  result = fusain_decode_byte(FUSAIN_START_BYTE, &rx_packet, &decoder);
  zassert_equal(result, FUSAIN_DECODE_INCOMPLETE,
      "Should accept START after garbage");
}

/* Test decoder receiving invalid length > 114 */
ZTEST(fusain_decoding, test_decode_invalid_length)
{
  fusain_decoder_t decoder;
  fusain_reset_decoder(&decoder);

  fusain_packet_t rx_packet;
  fusain_decode_result_t result;

  /* Send START byte */
  result = fusain_decode_byte(FUSAIN_START_BYTE, &rx_packet, &decoder);
  zassert_equal(result, FUSAIN_DECODE_INCOMPLETE, "Should accept START");

  /* Send invalid length (> 114) */
  result = fusain_decode_byte(FUSAIN_MAX_PAYLOAD_SIZE + 1, &rx_packet, &decoder);
  zassert_equal(result, FUSAIN_DECODE_INVALID_LENGTH,
      "Should reject length > 114");

  /* Decoder should be back in IDLE */
  result = fusain_decode_byte(0x42, &rx_packet, &decoder);
  zassert_equal(result, FUSAIN_DECODE_INCOMPLETE,
      "Should be in IDLE after invalid length");
}

/* Test decoder expecting END but receiving wrong byte */
ZTEST(fusain_decoding, test_decode_missing_end_byte)
{
  fusain_packet_t tx_packet;
  fusain_create_ping_request(&tx_packet, 0x0102030405060708);

  uint8_t buffer[FUSAIN_MAX_PACKET_SIZE * 2];
  int encoded_len = fusain_encode_packet(&tx_packet, buffer, sizeof(buffer));
  zassert_true(encoded_len > 0, "Encoding should succeed");

  /* Replace END byte with something else */
  buffer[encoded_len - 1] = 0x42;

  fusain_decoder_t decoder;
  fusain_reset_decoder(&decoder);

  fusain_packet_t rx_packet;
  fusain_decode_result_t result = FUSAIN_DECODE_INCOMPLETE;

  for (int i = 0; i < encoded_len; i++) {
    result = fusain_decode_byte(buffer[i], &rx_packet, &decoder);
    if (result != FUSAIN_DECODE_INCOMPLETE) {
      break;
    }
  }

  zassert_equal(result, FUSAIN_DECODE_INVALID_START,
      "Should fail when END byte is missing");
}

/* Test decoder with corrupted state (defensive code) */
ZTEST(fusain_decoding, test_decode_invalid_state)
{
  fusain_decoder_t decoder;
  fusain_reset_decoder(&decoder);

  /* Manually corrupt the decoder state to an invalid value */
  decoder.state = 255; /* Invalid state value */

  fusain_packet_t rx_packet;
  fusain_decode_result_t result;

  /* Send any byte - should trigger default case */
  result = fusain_decode_byte(0x42, &rx_packet, &decoder);
  zassert_equal(result, FUSAIN_DECODE_INVALID_START,
      "Invalid state should return error");

  /* Decoder should be reset to IDLE */
  zassert_equal(decoder.state, 0, "Should reset to IDLE after invalid state");
}

/* Test CBOR header decoding edge cases */
ZTEST(fusain_decoding, test_decode_cbor_header_errors)
{
  fusain_decoder_t decoder;
  fusain_reset_decoder(&decoder);

  fusain_packet_t rx_packet;
  fusain_decode_result_t result;

  /* Build a packet with invalid CBOR header (not 0x82 array)
   * We need a valid CRC so the CBOR decode path is actually tested */
  uint8_t crc_data[] = {
    3, /* length */
    0x01,
    0x00,
    0x00,
    0x00,
    0x00,
    0x00,
    0x00,
    0x00, /* address (LE) */
    0x83,
    0x30,
    0xF6, /* Invalid: 3-element array instead of 2 */
  };
  uint16_t crc = fusain_crc16(crc_data, sizeof(crc_data));

  uint8_t invalid_cbor[] = {
    FUSAIN_START_BYTE,
    3, /* length = 3 bytes of CBOR */
    0x01, 0x00, 0x00, 0x00, 0x00, 0x00, 0x00, 0x00, /* address */
    0x83, 0x30, 0xF6, /* Invalid: 3-element array instead of 2 */
    (uint8_t)(crc >> 8), (uint8_t)(crc & 0xFF), /* Valid CRC */
    FUSAIN_END_BYTE
  };

  for (size_t i = 0; i < sizeof(invalid_cbor); i++) {
    result = fusain_decode_byte(invalid_cbor[i], &rx_packet, &decoder);
    if (result != FUSAIN_DECODE_INCOMPLETE) {
      break;
    }
  }

  /* Should fail due to invalid CBOR header (0x83 != 0x82) */
  zassert_equal(result, FUSAIN_DECODE_INVALID_START,
      "Should reject packet with invalid CBOR header");
}

/* Test decoding with truncated CBOR payload (buffer_size < 2) */
ZTEST(fusain_decoding, test_decode_truncated_cbor)
{
  fusain_decoder_t decoder;
  fusain_reset_decoder(&decoder);

  fusain_packet_t rx_packet;
  fusain_decode_result_t result;

  /* Build a packet with truncated CBOR (only 1 byte, need at least 2)
   * This triggers line 112: if (buffer_size < 2) return -1 */
  uint8_t crc_data[] = {
    1, /* length */
    0x01,
    0x00,
    0x00,
    0x00,
    0x00,
    0x00,
    0x00,
    0x00, /* address (LE) */
    0x82, /* Just the array header, no type */
  };
  uint16_t crc = fusain_crc16(crc_data, sizeof(crc_data));

  uint8_t truncated[] = {
    FUSAIN_START_BYTE,
    1, /* length = 1 byte (too short for valid CBOR array) */
    0x01, 0x00, 0x00, 0x00, 0x00, 0x00, 0x00, 0x00, /* address */
    0x82, /* Just the array header, no type or payload */
    (uint8_t)(crc >> 8), (uint8_t)(crc & 0xFF), /* Valid CRC */
    FUSAIN_END_BYTE
  };

  for (size_t i = 0; i < sizeof(truncated); i++) {
    result = fusain_decode_byte(truncated[i], &rx_packet, &decoder);
    if (result != FUSAIN_DECODE_INCOMPLETE) {
      break;
    }
  }

  /* Should fail due to truncated CBOR (buffer_size < 2) */
  zassert_equal(result, FUSAIN_DECODE_INVALID_START,
      "Should reject packet with truncated CBOR");
}

/* Test decoding with unsupported CBOR type encoding (line 133) */
ZTEST(fusain_decoding, test_decode_unsupported_cbor_type)
{
  fusain_decoder_t decoder;
  fusain_reset_decoder(&decoder);

  fusain_packet_t rx_packet;
  fusain_decode_result_t result;

  /* Build a packet with unsupported type encoding (0x19 = uint16 follows)
   * This triggers line 133: return -1 for unsupported encoding */
  uint8_t crc_data[] = {
    5, /* length */
    0x01,
    0x00,
    0x00,
    0x00,
    0x00,
    0x00,
    0x00,
    0x00, /* address (LE) */
    0x82,
    0x19,
    0x00,
    0x30,
    0xF6, /* Array with uint16 type - unsupported */
  };
  uint16_t crc = fusain_crc16(crc_data, sizeof(crc_data));

  uint8_t unsupported[] = {
    FUSAIN_START_BYTE,
    5, /* length */
    0x01, 0x00, 0x00, 0x00, 0x00, 0x00, 0x00, 0x00, /* address */
    0x82, 0x19, 0x00, 0x30, 0xF6, /* Array with uint16 type - unsupported */
    (uint8_t)(crc >> 8), (uint8_t)(crc & 0xFF), /* Valid CRC */
    FUSAIN_END_BYTE
  };

  for (size_t i = 0; i < sizeof(unsupported); i++) {
    result = fusain_decode_byte(unsupported[i], &rx_packet, &decoder);
    if (result != FUSAIN_DECODE_INCOMPLETE) {
      break;
    }
  }

  /* Should fail due to unsupported CBOR encoding */
  zassert_equal(result, FUSAIN_DECODE_INVALID_START,
      "Should reject packet with unsupported CBOR type encoding");
}

/* Test decoding with zero-length CBOR payload (line 285)
 * This happens when packet->length == 0 after address bytes */
ZTEST(fusain_decoding, test_decode_zero_length_payload)
{
  fusain_decoder_t decoder;
  fusain_reset_decoder(&decoder);

  fusain_packet_t rx_packet;
  fusain_decode_result_t result;

  /* Build a packet with zero-length CBOR payload
   * This should trigger line 285: if (packet->length == 0) state = CRC1 */
  uint8_t crc_data[] = {
    0, /* length = 0 */
    0x01,
    0x00,
    0x00,
    0x00,
    0x00,
    0x00,
    0x00,
    0x00, /* address (LE) */
    /* No CBOR payload */
  };
  uint16_t crc = fusain_crc16(crc_data, sizeof(crc_data));

  uint8_t zero_len_packet[] = {
    FUSAIN_START_BYTE,
    0, /* length = 0 */
    0x01, 0x00, 0x00, 0x00, 0x00, 0x00, 0x00, 0x00, /* address */
    /* No CBOR payload bytes */
    (uint8_t)(crc >> 8), (uint8_t)(crc & 0xFF), /* Valid CRC */
    FUSAIN_END_BYTE
  };

  for (size_t i = 0; i < sizeof(zero_len_packet); i++) {
    result = fusain_decode_byte(zero_len_packet[i], &rx_packet, &decoder);
    if (result != FUSAIN_DECODE_INCOMPLETE) {
      break;
    }
  }

  /* Should fail because zero-length CBOR is invalid (can't extract msg_type) */
  zassert_equal(result, FUSAIN_DECODE_INVALID_START,
      "Should reject packet with zero-length CBOR payload");
}

/* Test decoding with uint8 type prefix but truncated (line 127) */
ZTEST(fusain_decoding, test_decode_truncated_uint8_type)
{
  fusain_decoder_t decoder;
  fusain_reset_decoder(&decoder);

  fusain_packet_t rx_packet;
  fusain_decode_result_t result;

  /* Build a packet with uint8 type prefix (0x18) but no value follows
   * This triggers line 127: if (buffer_size < 3) return -1 */
  uint8_t crc_data[] = {
    2, /* length = 2 bytes (array header + 0x18, but no value) */
    0x01,
    0x00,
    0x00,
    0x00,
    0x00,
    0x00,
    0x00,
    0x00, /* address (LE) */
    0x82,
    0x18, /* Array header + uint8 prefix, missing value */
  };
  uint16_t crc = fusain_crc16(crc_data, sizeof(crc_data));

  uint8_t truncated[] = {
    FUSAIN_START_BYTE,
    2, /* length */
    0x01, 0x00, 0x00, 0x00, 0x00, 0x00, 0x00, 0x00, /* address */
    0x82, 0x18, /* Array header + uint8 prefix, missing value */
    (uint8_t)(crc >> 8), (uint8_t)(crc & 0xFF), /* Valid CRC */
    FUSAIN_END_BYTE
  };

  for (size_t i = 0; i < sizeof(truncated); i++) {
    result = fusain_decode_byte(truncated[i], &rx_packet, &decoder);
    if (result != FUSAIN_DECODE_INCOMPLETE) {
      break;
    }
  }

  /* Should fail due to truncated uint8 type encoding */
  zassert_equal(result, FUSAIN_DECODE_INVALID_START,
      "Should reject packet with truncated uint8 type prefix");
}

/* Test suite setup */
ZTEST_SUITE(fusain_decoding, NULL, NULL, NULL, NULL, NULL);
```

## src/test_encoding.c
```c
/*
 * Copyright (c) 2025 Kaz Walker, Thermoquad
 * SPDX-License-Identifier: Apache-2.0
 *
 * Fusain Protocol Library - Packet Encoding Tests
 *
 * Wire format: [START][LENGTH][ADDRESS(8)][CBOR_PAYLOAD][CRC(2)][END]
 * CBOR payload contains [msg_type, payload_map]
 */

#include <fusain/fusain.h>
#include <string.h>
#include <zephyr/ztest.h>

/* Test basic packet encoding */
ZTEST(fusain_encoding, test_encode_basic)
{
  fusain_packet_t packet = {
    .length = 5,
    .msg_type = 0x30, /* For routing purposes only, msg_type is in CBOR */
  };
  memcpy(packet.payload, "HELLO", 5);

  uint8_t buffer[FUSAIN_MAX_PACKET_SIZE * 2];
  int len = fusain_encode_packet(&packet, buffer, sizeof(buffer));

  zassert_true(len > 0, "Encoding should succeed");
  zassert_equal(buffer[0], FUSAIN_START_BYTE, "First byte should be START");
  zassert_equal(buffer[len - 1], FUSAIN_END_BYTE, "Last byte should be END");
}

/* Test encoding with minimal CBOR payload */
ZTEST(fusain_encoding, test_encode_empty_payload)
{
  /* In CBOR mode, even "empty" messages have at least [type, nil] = 3-4 bytes
   * Create a packet using create_ping_request which has nil payload */
  fusain_packet_t packet;
  fusain_create_ping_request(&packet, 0);

  uint8_t buffer[FUSAIN_MAX_PACKET_SIZE * 2];
  int len = fusain_encode_packet(&packet, buffer, sizeof(buffer));

  zassert_true(len > 0, "Minimal CBOR payload should encode successfully");
  /* Minimum: START(1) + LENGTH(1) + ADDR(8) + CBOR(3+) + CRC(2) + END(1) = 16+ */
  zassert_true(len >= 16, "Encoded size should be at least minimum");
}

/* Test encoding with maximum payload */
ZTEST(fusain_encoding, test_encode_max_payload)
{
  fusain_packet_t packet = {
    .length = FUSAIN_MAX_PAYLOAD_SIZE,
    .msg_type = 0x30,
  };

  /* Fill with pattern */
  for (int i = 0; i < packet.length; i++) {
    packet.payload[i] = i & 0xFF;
  }

  uint8_t buffer[FUSAIN_MAX_PACKET_SIZE * 2];
  int len = fusain_encode_packet(&packet, buffer, sizeof(buffer));

  zassert_true(len > 0, "Max payload should encode successfully");
  zassert_equal(buffer[0], FUSAIN_START_BYTE, "Should start with START byte");
  zassert_equal(buffer[len - 1], FUSAIN_END_BYTE, "Should end with END byte");
}

/* Test encoding with byte stuffing required */
ZTEST(fusain_encoding, test_encode_byte_stuffing)
{
  fusain_packet_t packet = {
    .length = 3,
    .msg_type = 0x30,
  };
  packet.payload[0] = FUSAIN_START_BYTE; /* Requires escaping */
  packet.payload[1] = FUSAIN_END_BYTE; /* Requires escaping */
  packet.payload[2] = FUSAIN_ESC_BYTE; /* Requires escaping */

  uint8_t buffer[FUSAIN_MAX_PACKET_SIZE * 2];
  int len = fusain_encode_packet(&packet, buffer, sizeof(buffer));

  zassert_true(len > 0, "Encoding with stuffing should succeed");

  /* Count escape bytes in the encoded output */
  int esc_count = 0;
  for (int i = 1; i < len - 1; i++) { /* Skip START and END */
    if (buffer[i] == FUSAIN_ESC_BYTE) {
      esc_count++;
    }
  }

  zassert_true(esc_count > 0, "Should have escape bytes");
}

/* Test encoding error handling */
ZTEST(fusain_encoding, test_encode_errors)
{
  fusain_packet_t packet = {
    .length = 10,
    .msg_type = 0x20,
  };

  uint8_t small_buffer[10];
  uint8_t large_buffer[FUSAIN_MAX_PACKET_SIZE * 2];

  /* Test NULL packet */
  int len = fusain_encode_packet(NULL, small_buffer, sizeof(small_buffer));
  zassert_true(len < 0, "NULL packet should fail");

  /* Test NULL buffer */
  len = fusain_encode_packet(&packet, NULL, 100);
  zassert_true(len < 0, "NULL buffer should fail");

  /* Test buffer too small */
  len = fusain_encode_packet(&packet, small_buffer, 2);
  zassert_true(len < 0, "Too small buffer should fail");

  /* Test invalid payload length (use large buffer so we hit length check) */
  packet.length = FUSAIN_MAX_PAYLOAD_SIZE + 1;
  len = fusain_encode_packet(&packet, large_buffer, sizeof(large_buffer));
  zassert_equal(len, -2, "Oversized payload should return -2");
}

/* Test encoding determinism */
ZTEST(fusain_encoding, test_encode_determinism)
{
  fusain_packet_t packet = {
    .length = 8,
    .msg_type = 0x31,
  };
  memcpy(packet.payload, "TESTDATA", 8);

  uint8_t buffer1[FUSAIN_MAX_PACKET_SIZE * 2];
  uint8_t buffer2[FUSAIN_MAX_PACKET_SIZE * 2];

  int len1 = fusain_encode_packet(&packet, buffer1, sizeof(buffer1));
  int len2 = fusain_encode_packet(&packet, buffer2, sizeof(buffer2));

  zassert_equal(len1, len2, "Encoded length should be consistent");
  zassert_mem_equal(buffer1, buffer2, len1, "Encoded data should be identical");
}

/* Test buffer overflow at various encoding stages */
ZTEST(fusain_encoding, test_encode_buffer_overflow_stages)
{
  fusain_packet_t packet = {
    .length = 0,
    .address = 0x0102030405060708,
    .msg_type = 0x30,
  };

  uint8_t buffer[256];
  int len;

  /* Buffer size 0 - fails initial validation */
  len = fusain_encode_packet(&packet, buffer, 0);
  zassert_equal(len, -1, "Size 0 should fail validation");

  /* Buffer too small after START - fails at LENGTH */
  len = fusain_encode_packet(&packet, buffer, 2);
  zassert_true(len < 0, "Size 2 should fail during LENGTH stuffing");

  /* Buffer exhausted during ADDRESS stuffing */
  len = fusain_encode_packet(&packet, buffer, 5);
  zassert_true(len < 0, "Size 5 should fail during ADDRESS stuffing");

  /* Buffer exhausted during CRC stuffing */
  len = fusain_encode_packet(&packet, buffer, 11);
  zassert_true(len < 0, "Size 11 should fail during CRC stuffing");

  /* Buffer exhausted at END byte */
  len = fusain_encode_packet(&packet, buffer, 12);
  zassert_true(len < 0, "Size 12 should fail at END byte");
}

/* Test buffer overflow during payload stuffing */
ZTEST(fusain_encoding, test_encode_payload_overflow)
{
  fusain_packet_t packet = {
    .length = 10,
    .address = 0,
    .msg_type = 0x30,
  };
  memset(packet.payload, 0x42, 10);

  uint8_t buffer[20];
  int len;

  /* Buffer too small for payload
   * Need: START(1) + LENGTH(1) + ADDR(8) + PAYLOAD(10) + CRC(2) + END(1) = 23 */
  len = fusain_encode_packet(&packet, buffer, 18);
  zassert_true(len < 0, "Should fail during payload stuffing");
}

/* Test stuff_byte overflow paths with escape sequences */
ZTEST(fusain_encoding, test_encode_escape_overflow)
{
  fusain_packet_t packet = {
    .length = 3,
    .address = 0,
    .msg_type = 0x30,
  };
  /* Payload bytes that require escaping */
  packet.payload[0] = FUSAIN_START_BYTE;
  packet.payload[1] = FUSAIN_END_BYTE;
  packet.payload[2] = FUSAIN_ESC_BYTE;

  uint8_t buffer[256];
  int len;

  /* With escaping, the 3 payload bytes need 6 bytes.
   * Minimal packet needs: START(1) + LENGTH(1) + ADDR(8) + PAYLOAD(6) + CRC(2) + END(1) = 19
   * Size 18 should fail */
  len = fusain_encode_packet(&packet, buffer, 18);
  zassert_true(len < 0, "Should fail when escaping payload bytes");
}

/* Test stuff_byte normal byte overflow */
ZTEST(fusain_encoding, test_encode_normal_byte_overflow)
{
  fusain_packet_t packet = {
    .length = 5,
    .address = 0,
    .msg_type = 0x30,
  };
  memset(packet.payload, 0x42, 5); /* Normal bytes, no escaping needed */

  uint8_t buffer[256];
  int len;

  /* Packet with 5 normal payload bytes needs:
   * START(1) + LENGTH(1) + ADDR(8) + PAYLOAD(5) + CRC(2) + END(1) = 18
   * Size 16 should fail during normal payload byte stuffing */
  len = fusain_encode_packet(&packet, buffer, 16);
  zassert_true(len < 0, "Should fail during normal byte stuffing");
}

/* Test overflow when address bytes need escaping */
ZTEST(fusain_encoding, test_encode_type_escape_overflow)
{
  fusain_packet_t packet = {
    .length = 0,
    .address = 0x007E7E7E, /* Low 3 bytes are START_BYTE and need escaping */
    .msg_type = 0x30,
  };

  uint8_t buffer[256];
  int len;

  /* With 3 escaped address bytes (6 bytes total for those 3):
   * START(1) + LENGTH(1) + ADDR(5 normal + 6 escaped = 11) + CRC(2) + END(1) = 16
   * Size 13 should fail during address escaping */
  len = fusain_encode_packet(&packet, buffer, 13);
  zassert_true(len < 0, "Should fail when ADDRESS bytes need escaping");
}

/* Test overflow when address byte needs escaping */
ZTEST(fusain_encoding, test_encode_address_escape_overflow)
{
  fusain_packet_t packet = {
    .length = 0,
    .address = 0x7E7E7E7E7E7E7E7EULL, /* All 8 bytes are START_BYTE */
    .msg_type = 0x30,
  };

  uint8_t buffer[256];
  int len;

  /* With all 8 address bytes needing escape (16 bytes):
   * START(1) + LENGTH(1) + ADDR(16) + CRC(2) + END(1) = 21
   * Buffer size 14 should fail during address byte stuffing */
  len = fusain_encode_packet(&packet, buffer, 14);
  zassert_true(len < 0, "Should fail when ADDRESS bytes need escaping");
}

/* Test overflow during CRC stuffing */
ZTEST(fusain_encoding, test_encode_crc_escape_overflow)
{
  fusain_packet_t packet = {
    .length = 0,
    .address = 0x00007E7E, /* Low 2 bytes need escaping */
    .msg_type = 0x42,
  };

  uint8_t buffer[256];
  int len;

  /* With 2 escaped address bytes:
   * START(1) + LENGTH(1) + ADDR(6 normal + 4 escaped = 10) + CRC(2) + END(1) = 15
   * Buffer 13 should fail at CRC stuffing or END */
  len = fusain_encode_packet(&packet, buffer, 13);
  zassert_true(len < 0, "Should fail during CRC stuffing or END");
}

/* Test stuff_byte escape overflow path specifically */
ZTEST(fusain_encoding, test_stuff_byte_escape_boundary)
{
  /* Create scenario where we have exactly 1 byte left in buffer
   * but need to write an escaped byte (2 bytes). */
  fusain_packet_t packet = {
    .length = 100,
    .address = 0,
    .msg_type = 0x30,
  };
  /* Fill most of payload with normal bytes */
  memset(packet.payload, 0x42, 100);
  /* Put escape-needing byte near the end */
  packet.payload[99] = FUSAIN_START_BYTE;

  uint8_t buffer[256];
  int len;

  /* Normal encoding: START(1) + LENGTH(1) + ADDR(8) + PAYLOAD(100) + CRC(2) + END(1) = 113
   * With one escaped byte in payload: 114
   * Try buffer of 113 to trigger escape overflow */
  len = fusain_encode_packet(&packet, buffer, 113);
  zassert_true(len < 0, "Should fail when escape needs 2 bytes but only 1 left");
}

/* Test suite setup */
ZTEST_SUITE(fusain_encoding, NULL, NULL, NULL, NULL, NULL);
```

## src/test_fuzz.c
```c
/*
 * Copyright (c) 2025 Kaz Walker, Thermoquad
 * SPDX-License-Identifier: Apache-2.0
 *
 * Fusain Protocol Library - Fuzz Testing
 */

#include <fusain/fusain.h>
#include <string.h>
#include <zephyr/random/random.h>
#include <zephyr/ztest.h>

/* Simple LCG random number generator for reproducibility */
static uint32_t fuzz_seed;
static uint32_t initial_seed;

__attribute__((unused)) static void* fuzz_suite_setup(void)
{
  /* Use Kconfig seed if set (non-zero), otherwise random */
  if (CONFIG_FUSAIN_TEST_FUZZ_SEED != 0) {
    fuzz_seed = CONFIG_FUSAIN_TEST_FUZZ_SEED;
  } else {
    fuzz_seed = sys_rand32_get();
  }
  initial_seed = fuzz_seed;
  printk("Fuzz seed: 0x%08X (set CONFIG_FUSAIN_TEST_FUZZ_SEED to reproduce)\n",
      initial_seed);
  return NULL;
}

static uint32_t fuzz_rand(void)
{
  fuzz_seed = (fuzz_seed * 1103515245 + 12345) & 0x7FFFFFFF;
  return fuzz_seed;
}

static uint8_t fuzz_rand_byte(void)
{
  return fuzz_rand() & 0xFF;
}

/* Create a random valid packet using the create_* helpers */
static void fuzz_create_random_packet(fusain_packet_t* packet)
{
  uint64_t addr = ((uint64_t)fuzz_rand() << 32) | fuzz_rand();

  switch (fuzz_rand() % 16) {
  case 0: {
    fusain_cmd_motor_config_t cfg = {
      .motor = fuzz_rand_byte(),
      .pwm_period = fuzz_rand(),
      .pid_kp = (double)fuzz_rand() / 1000.0,
      .pid_ki = (double)fuzz_rand() / 1000.0,
      .pid_kd = (double)fuzz_rand() / 1000.0,
      .max_rpm = fuzz_rand(),
      .min_rpm = fuzz_rand(),
      .min_pwm_duty = fuzz_rand(),
    };
    fusain_create_motor_config(packet, addr, &cfg);
    break;
  }
  case 1: {
    fusain_cmd_pump_config_t cfg = {
      .pump = fuzz_rand_byte(),
      .pulse_ms = fuzz_rand(),
      .recovery_ms = fuzz_rand(),
    };
    fusain_create_pump_config(packet, addr, &cfg);
    break;
  }
  case 2: {
    fusain_cmd_temp_config_t cfg = {
      .thermometer = fuzz_rand_byte(),
      .pid_kp = (double)fuzz_rand() / 1000.0,
      .pid_ki = (double)fuzz_rand() / 1000.0,
      .pid_kd = (double)fuzz_rand() / 1000.0,
    };
    fusain_create_temp_config(packet, addr, &cfg);
    break;
  }
  case 3: {
    fusain_cmd_glow_config_t cfg = {
      .glow = fuzz_rand_byte(),
      .max_duration_ms = fuzz_rand(),
    };
    fusain_create_glow_config(packet, addr, &cfg);
    break;
  }
  case 4:
    fusain_create_state_command(packet, addr, fuzz_rand_byte(), (int32_t)fuzz_rand());
    break;
  case 5:
    fusain_create_pump_command(packet, addr, fuzz_rand_byte(), fuzz_rand());
    break;
  case 6:
    fusain_create_motor_command(packet, addr, fuzz_rand_byte(), fuzz_rand());
    break;
  case 7:
    fusain_create_ping_request(packet, addr);
    break;
  case 8:
    fusain_create_ping_response(packet, addr, fuzz_rand());
    break;
  case 9:
    fusain_create_discovery_request(packet, addr);
    break;
  case 10:
    fusain_create_device_announce(packet, addr, fuzz_rand_byte(),
        fuzz_rand_byte(), fuzz_rand_byte(), fuzz_rand_byte());
    break;
  case 11:
    /* state and error_code are constrained to .le 255 in CDDL */
    fusain_create_state_data(packet, addr, fuzz_rand() % 2,
        fuzz_rand_byte(), fuzz_rand_byte(), fuzz_rand());
    break;
  case 12:
    fusain_create_data_subscription(packet, addr, ((uint64_t)fuzz_rand() << 32) | fuzz_rand());
    break;
  case 13:
    fusain_create_data_unsubscribe(packet, addr, ((uint64_t)fuzz_rand() << 32) | fuzz_rand());
    break;
  case 14:
    fusain_create_timeout_config(packet, addr, fuzz_rand() % 2, fuzz_rand());
    break;
  case 15:
    /* Emergency stop via state_command with EMERGENCY mode */
    fusain_create_state_command(packet, addr, FUSAIN_MODE_EMERGENCY, 0);
    break;
  }
}

/* Fuzz encoding with random payloads */
ZTEST(fusain_fuzz, test_fuzz_encoding)
{
  int success_count = 0;
  int expected_fail_count = 0;

  for (int round = 0; round < CONFIG_FUSAIN_TEST_FUZZ_ROUNDS; round++) {
    fusain_packet_t packet;

    /* Random length (including invalid values to test error handling) */
    int length = fuzz_rand() % (FUSAIN_MAX_PAYLOAD_SIZE + 50);
    packet.length = length;

    /* Random message type */
    packet.msg_type = fuzz_rand_byte();

    /* Fill payload with random data */
    for (int i = 0; i < FUSAIN_MAX_PAYLOAD_SIZE; i++) {
      packet.payload[i] = fuzz_rand_byte();
    }

    uint8_t buffer[FUSAIN_MAX_PACKET_SIZE * 2];
    int encoded_len = fusain_encode_packet(&packet, buffer, sizeof(buffer));

    if (length <= FUSAIN_MAX_PAYLOAD_SIZE) {
      /* Should succeed for valid lengths */
      zassert_true(encoded_len > 0,
          "Round %d: Valid packet should encode (len=%d)",
          round, length);
      success_count++;

      /* Verify framing */
      zassert_equal(buffer[0], FUSAIN_START_BYTE,
          "Round %d: Should start with START byte", round);
      zassert_equal(buffer[encoded_len - 1], FUSAIN_END_BYTE,
          "Round %d: Should end with END byte", round);
    } else {
      /* Should fail for invalid lengths */
      zassert_true(encoded_len < 0,
          "Round %d: Invalid packet should fail (len=%d)",
          round, length);
      expected_fail_count++;
    }
  }

  printk("Fuzz encoding: %d successes, %d expected failures\n", success_count,
      expected_fail_count);
}

/* Fuzz decoding with random byte streams */
ZTEST(fusain_fuzz, test_fuzz_decoding_random)
{
  int detected_errors = 0;

  for (int round = 0; round < CONFIG_FUSAIN_TEST_FUZZ_ROUNDS; round++) {
    fusain_decoder_t decoder;
    fusain_reset_decoder(&decoder);

    fusain_packet_t packet;
    uint8_t random_data[100];

    /* Generate random byte stream */
    for (size_t i = 0; i < sizeof(random_data); i++) {
      random_data[i] = fuzz_rand_byte();
    }

    /* Feed to decoder */
    fusain_decode_result_t result = FUSAIN_DECODE_INCOMPLETE;
    for (size_t i = 0; i < sizeof(random_data); i++) {
      result = fusain_decode_byte(random_data[i], &packet, &decoder);

      /* Decoder should never crash, only return valid states */
      zassert_true(result >= FUSAIN_DECODE_OK && result <= FUSAIN_DECODE_BUFFER_OVERFLOW,
          "Round %d: Decoder should return valid result",
          round);

      if (result != FUSAIN_DECODE_INCOMPLETE && result != FUSAIN_DECODE_OK) {
        detected_errors++;
        break;
      }
    }
  }

  printk("Fuzz decoding: Detected %d errors in random data\n", detected_errors);
}

/* Fuzz round-trip with valid CBOR packets */
ZTEST(fusain_fuzz, test_fuzz_roundtrip)
{
  int success_count = 0;
  int skipped_count = 0;

  for (int round = 0; round < CONFIG_FUSAIN_TEST_FUZZ_ROUNDS; round++) {
    fusain_packet_t tx_packet;
    fuzz_create_random_packet(&tx_packet);

    /* Skip packets where CBOR encoding failed (length=0 means encoding error) */
    if (tx_packet.length == 0) {
      skipped_count++;
      continue;
    }

    /* Encode */
    uint8_t buffer[FUSAIN_MAX_PACKET_SIZE * 2];
    int encoded_len = fusain_encode_packet(&tx_packet, buffer, sizeof(buffer));

    zassert_true(encoded_len > 0, "Round %d: Encoding should succeed", round);

    /* Decode */
    fusain_decoder_t decoder;
    fusain_reset_decoder(&decoder);

    fusain_packet_t rx_packet;
    fusain_decode_result_t result = FUSAIN_DECODE_INCOMPLETE;

    for (int i = 0; i < encoded_len; i++) {
      result = fusain_decode_byte(buffer[i], &rx_packet, &decoder);
    }

    /* Should decode successfully */
    zassert_equal(result, FUSAIN_DECODE_OK,
        "Round %d: Decoding should succeed", round);

    /* Verify data integrity */
    zassert_equal(rx_packet.length, tx_packet.length,
        "Round %d: Length should match", round);
    zassert_equal(rx_packet.msg_type, tx_packet.msg_type,
        "Round %d: Type should match", round);
    zassert_equal(rx_packet.address, tx_packet.address,
        "Round %d: Address should match", round);
    zassert_mem_equal(rx_packet.payload, tx_packet.payload, tx_packet.length,
        "Round %d: Payload should match", round);

    success_count++;
  }

  printk("Fuzz round-trip: %d successful, %d skipped (CBOR encoding failures)\n",
      success_count, skipped_count);
}

/* Fuzz CRC with edge cases */
ZTEST(fusain_fuzz, test_fuzz_crc)
{
  for (int round = 0; round < CONFIG_FUSAIN_TEST_FUZZ_ROUNDS; round++) {
    uint8_t data[FUSAIN_MAX_PAYLOAD_SIZE];
    int length = fuzz_rand() % (FUSAIN_MAX_PAYLOAD_SIZE + 1);

    /* Fill with random data */
    for (int i = 0; i < length; i++) {
      data[i] = fuzz_rand_byte();
    }

    /* Calculate CRC twice - should be deterministic */
    uint16_t crc1 = fusain_crc16(data, length);
    uint16_t crc2 = fusain_crc16(data, length);

    zassert_equal(crc1, crc2, "Round %d: CRC should be deterministic",
        round);

    /* Flip a bit and verify CRC changes (if length > 0) */
    if (length > 0) {
      data[0] ^= 0x01;
      uint16_t crc3 = fusain_crc16(data, length);
      zassert_not_equal(crc1, crc3,
          "Round %d: CRC should change with data", round);
    }
  }
}

/* Fuzz byte stuffing edge cases - tests addresses with special bytes */
ZTEST(fusain_fuzz, test_fuzz_byte_stuffing)
{
  int stuffed_count = 0;
  int skipped_count = 0;

  for (int round = 0; round < CONFIG_FUSAIN_TEST_FUZZ_ROUNDS; round++) {
    fusain_packet_t packet;
    fuzz_create_random_packet(&packet);

    /* Skip packets where CBOR encoding failed */
    if (packet.length == 0) {
      skipped_count++;
      continue;
    }

    /* Force special bytes in the address to trigger byte stuffing */
    bool force_stuffing = (round % 10) == 0;
    if (force_stuffing) {
      uint8_t special[] = { FUSAIN_START_BYTE, FUSAIN_END_BYTE, FUSAIN_ESC_BYTE };
      /* Create an address with special bytes embedded */
      uint64_t addr = 0;
      for (int i = 0; i < 8; i++) {
        addr |= ((uint64_t)special[fuzz_rand() % 3]) << (i * 8);
      }
      packet.address = addr;
    }

    /* Encode and decode */
    uint8_t buffer[FUSAIN_MAX_PACKET_SIZE * 2];
    int encoded_len = fusain_encode_packet(&packet, buffer, sizeof(buffer));

    zassert_true(encoded_len > 0, "Round %d: Encoding should succeed", round);

    fusain_decoder_t decoder;
    fusain_reset_decoder(&decoder);

    fusain_packet_t rx_packet;
    fusain_decode_result_t result = FUSAIN_DECODE_INCOMPLETE;

    for (int i = 0; i < encoded_len; i++) {
      result = fusain_decode_byte(buffer[i], &rx_packet, &decoder);
    }

    zassert_equal(result, FUSAIN_DECODE_OK,
        "Round %d: Decoding should succeed", round);
    zassert_equal(rx_packet.address, packet.address,
        "Round %d: Address should survive stuffing", round);
    zassert_mem_equal(rx_packet.payload, packet.payload, packet.length,
        "Round %d: Payload should survive stuffing", round);

    if (force_stuffing) {
      stuffed_count++;
    }
  }

  printk("Fuzz byte stuffing: %d with forced stuffing, %d skipped\n",
      stuffed_count, skipped_count);
}

/* Fuzz decoder state machine with injected errors */
ZTEST(fusain_fuzz, test_fuzz_decoder_errors)
{
  int error_recovery_count = 0;
  int skipped_count = 0;

  for (int round = 0; round < CONFIG_FUSAIN_TEST_FUZZ_ROUNDS; round++) {
    /* Create valid CBOR packet */
    fusain_packet_t tx_packet;
    fuzz_create_random_packet(&tx_packet);

    /* Skip packets where CBOR encoding failed */
    if (tx_packet.length == 0) {
      skipped_count++;
      continue;
    }

    uint8_t buffer[FUSAIN_MAX_PACKET_SIZE * 2];
    int encoded_len = fusain_encode_packet(&tx_packet, buffer, sizeof(buffer));

    zassert_true(encoded_len > 0, "Round %d: Encoding should succeed", round);

    /* Inject random corruption */
    if (encoded_len > 5) {
      int corrupt_idx = 1 + (fuzz_rand() % (encoded_len - 2));
      buffer[corrupt_idx] ^= 0xFF;
    }

    /* Decode corrupted packet */
    fusain_decoder_t decoder;
    fusain_reset_decoder(&decoder);

    fusain_packet_t rx_packet;
    fusain_decode_result_t result = FUSAIN_DECODE_INCOMPLETE;

    for (int i = 0; i < encoded_len; i++) {
      result = fusain_decode_byte(buffer[i], &rx_packet, &decoder);
      if (result != FUSAIN_DECODE_INCOMPLETE) {
        break;
      }
    }

    /* Should detect error (not crash) */
    if (result != FUSAIN_DECODE_OK) {
      error_recovery_count++;

      /* Reset and try valid packet */
      fusain_reset_decoder(&decoder);
      encoded_len = fusain_encode_packet(&tx_packet, buffer, sizeof(buffer));

      result = FUSAIN_DECODE_INCOMPLETE;
      for (int i = 0; i < encoded_len; i++) {
        result = fusain_decode_byte(buffer[i], &rx_packet, &decoder);
      }

      zassert_equal(result, FUSAIN_DECODE_OK,
          "Round %d: Should recover after error", round);

      /* Verify recovered packet matches original */
      zassert_equal(rx_packet.length, tx_packet.length,
          "Round %d: Length should match after recovery", round);
      zassert_equal(rx_packet.msg_type, tx_packet.msg_type,
          "Round %d: Type should match after recovery", round);
      zassert_equal(rx_packet.address, tx_packet.address,
          "Round %d: Address should match after recovery", round);
      zassert_mem_equal(rx_packet.payload, tx_packet.payload, tx_packet.length,
          "Round %d: Payload should match after recovery", round);
    }
  }

  printk("Fuzz decoder errors: %d error recoveries, %d skipped\n",
      error_recovery_count, skipped_count);
}

/* Test suite setup - prints seed at start for reproducibility */
ZTEST_SUITE(fusain_fuzz, NULL, fuzz_suite_setup, NULL, NULL, NULL);
```
