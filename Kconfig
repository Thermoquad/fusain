## Kconfig
```kconfig
# Copyright (c) 2025 Kaz Walker, Thermoquad
# SPDX-License-Identifier: Apache-2.0

menuconfig FUSAIN
	bool "Fusain Protocol Library"
	select ZCBOR
	select CRC
	help
	  Enable the Fusain protocol encoder/decoder library.
	  This library provides CBOR-encoded packet payloads, CRC-16-CCITT
	  error detection, byte stuffing, and stateful packet decoding for
	  the Fusain protocol.

	  In Zephyr mode, this library uses:
	  - zcbor for CBOR encoding/decoding (auto-selected)
	  - Zephyr's native crc16_itu_t() for CRC calculation

	  It does NOT require CONFIG_SERIAL (protocol layer only, no UART).

if FUSAIN

config FUSAIN_LOG_LEVEL
	int "Fusain Protocol Log Level"
	default 3
	range 0 4
	help
	  Set the log level for the Fusain protocol library.
	  0 = OFF, 1 = ERROR, 2 = WARNING, 3 = INFO, 4 = DEBUG

config FUSAIN_NET_BUF
	bool "Net buffer decoder API"
	default y
	select NET_BUF
	help
	  Enable fusain_decode_byte_to_net_buf() for convenient packet
	  decoding with net_buf output. Packets are allocated from a
	  net_buf pool for easy forwarding to Bluetooth, TCP, or other
	  Zephyr subsystems.

endif # FUSAIN
```

## tests/testcase.yaml
```yaml
# SPDX-License-Identifier: Apache-2.0

tests:
  libraries.fusain.functional:
    tags:
      - fusain
      - protocol
      - functional
    platform_allow:
      - native_sim
    integration_platforms:
      - native_sim
    harness: ztest
    timeout: 60

  libraries.fusain.fuzz:
    tags:
      - fusain
      - protocol
      - fuzz
    slow: true
    platform_allow:
      - native_sim
    integration_platforms:
      - native_sim
    harness: ztest
    timeout: 120
```

## west.yml
```yaml
# SPDX-License-Identifier: Apache-2.0
# West manifest for standalone CI testing of fusain module
manifest:
  version: "1.0"

  remotes:
    - name: zephyrproject-rtos
      url-base: https://github.com/zephyrproject-rtos

  projects:
    - name: zephyr
      remote: zephyrproject-rtos
      revision: v4.3.0
      import:
        name-allowlist:
          - zcbor

  self:
    path: fusain
```
